// Copyright 2021 Manna Harbour
// https://github.com/manna-harbour/miryoku

#include "../miryoku/custom_config.h"
#include "../miryoku/mapping/42/corne.h"
#include "../miryoku/miryoku.dtsi"

CONFIG_ZMK_DISPLAY=y/
CONFIG_ZMK_BLE_EXPERIMENTAL_CONN=y/
CONFIG_BT_CTLR_TX_PWR_PLUS_8=y
